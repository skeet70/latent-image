xm1_loader_base = 0x40000;
xm1_loader_prepare2 = 0x43a3c;
xm1_loader_continue1 = 0x43a58;
xm1_loader_continue2 = 0x44a50;
xm1_loader_continue3 = 0x4cea0;
xm1_loader_continue4 = 0x4ce78;
xm1_loader_continue6 = 0x43ac0;
xm1_loader_auto_ready = 0x43f9c;
xm1_loader_activate_timers = 0x4bf3c;
xm1_loader_ready = 0x4005927c;
INCLUDE loader-orchestration.ld
