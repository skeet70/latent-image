xm1_loader_base = 0xd0000;
xm1_loader_prepare2 = 0xd39f0;
xm1_loader_continue1 = 0xd3a0c;
xm1_loader_continue2 = 0xd4a10;
xm1_loader_continue3 = 0xdce60;
xm1_loader_continue4 = 0xdce38;
xm1_loader_continue6 = 0xd3a7c;
xm1_loader_auto_ready = 0xd3f58;
xm1_loader_activate_timers = 0xdbefc;
xm1_loader_ready = 0x400e923c;
INCLUDE loader-orchestration.ld
